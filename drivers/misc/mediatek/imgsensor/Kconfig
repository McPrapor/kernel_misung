## drivers/misc/mediatek/imgsensor/Kconfig
```kconfig
config MTK_IMGSENSOR
  bool CONFIG_MTK_IMGSENSOR
  default n
  help
    CONFIG_MTK_IMGSENSOR

config MTK_EFUSE_DOWNGRADE
  bool "CONFIG_MTK_EFUSE_DOWNGRADE"
  default n
  help
    CONFIG_MTK_EFUSE_DOWNGRADE

config V36BML_CAMERA
  bool CONFIG_V36BML_CAMERA
  default n
  help
    HTC v36bml camera related option
```

## drivers/misc/mediatek/leds/Kconfig
```kconfig
config MTK_LEDS
	tristate "MediaTek LED Support"
	depends on LEDS_CLASS
	---help---
	  This selects the MediaTek(R) LEDs connected to MediaTek chips.
	  If you want to use MediaTek(R) LEDs support, say Y or M here.
	  If unsure, say N.
	  Mediatek LED module includes backlight, indicate LED, keypad LED, button LED etc.

config V36BML_LED
        tristate "V36BML_LED current Support"
        depends on LEDS_CLASS
        ---help---
          This selects the V36BML LEDs connected to MediaTek chips.
          If you want to use V36BML LEDs support, say Y or M here.
          If unsure, say N.

config LIGHTNESS_MAPPING_VALUE
	int "LIGHTNESS_MAPPING_VALUE"
	default 255
 	---help---
	  Backlight brightness mapping value, from 0 to 255.

config TB8173_EVB
	bool "Support TB8173 EVB board"
```
